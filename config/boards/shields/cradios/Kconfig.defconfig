## config/boards/shields/cradios/Kconfig.defconfig
```kconfig
# Copyright (c) 2020 The ZMK Contributors
# SPDX-License-Identifier: MIT

if SHIELD_CRADIOS_LEFT

config ZMK_KEYBOARD_NAME
	default "Cradios"

config ZMK_SPLIT_BLE_ROLE_CENTRAL
	default y

endif

if SHIELD_CRADIOS_RIGHT

config ZMK_KEYBOARD_NAME
	default "Cradios_Right"

endif

if SHIELD_CRADIOS_RIGHT || SHIELD_CRADIOS_LEFT

config ZMK_SPLIT
	default y

endif
```
